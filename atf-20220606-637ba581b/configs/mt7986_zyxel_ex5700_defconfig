## atf-20220606-637ba581b/configs/mt7986_zyxel_ex5700_defconfig
```kconfig
CONFIG_PLAT_MT7986=y
CONFIG_TARGET_FIP_NO_SEC_BOOT=y
CONFIG_FLASH_DEVICE_SPIM_NAND=y
CONFIG_DRAM_DDR4=y
CONFIG_SPIM_NAND_TYPE="spim:4k+256"
```
